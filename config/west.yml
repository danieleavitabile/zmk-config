## west.yml
```yaml
manifest:
  version: 1

  remotes:
    - name: zmk
      url-base: https://github.com/zmkfirmware

  projects:
    - name: zmk
      remote: zmk
      revision: main
      import: app/west.yml
    
    - name: zmk-halcyon-module
      url: https://github.com/splitkb/zmk-halcyon-module.git
      revision: main

  self:
    path: config
    import: build.yaml
```
